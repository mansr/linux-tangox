## Documentation/devicetree/bindings/i2c/sigma,smp8642-i2c.txt
```
Sigma Designs SMP8642 I2C master

Required properties:
- compatible: should be "sigma,smp8642-i2c"
- reg: physical address space of the device
- interrupts: the interrupt of the device
- clocks: phandle of the clock for the device
- #address-cells: should be <1>
- #size-cells: should be <0>

Optional properties:
- clock-frequency: frequency of bus clock in Hz, default 100kHz

Example:

i2c@10480 {
	compatible = "sigma,smp8642-i2c";
	reg = <0x10480 0x2c>;
	interrupts = <22 IRQ_TYPE_LEVEL_HIGH>;
	clocks = <&sys_clk>;
	clock-frequency = <100000>;
	#address-cells = <1>;
	#size-cells = <0>;
};
```

## Documentation/devicetree/bindings/net/aurora,nb8800.txt
```
* Aurora VLSI AU-NB8800 Ethernet controller

Required properties:
- compatible: Should be "sigma,<chip>-ethernet", "aurora,nb8800"
- reg: Should be MMIO address space of the device
- interrupts: Should contain the interrupt specifier for the device
- interrupt-parent: Should be a phandle for the interrupt controller
- clocks: Should be a phandle for the clock for the device
- #address-cells: Should be <1>
- #size-cells: Should be <0>

Common properties described in ethernet.txt:
- local-mac-address
- mac-address
- phy-handle
- phy-mode

The attached PHY should be specified in a child node as per phy.txt.

Example:

ethernet@26000 {
	compatible = "sigma,smp8642-ethernet", "aurora,nb8800";
	reg = <0x26000 0x800>;
	interrupts = <38>;
	clocks = <&sys_clk>;
	max-speed = <1000>;
	phy-connection-type = "rgmii";
        phy-handle = <&eth0_phy>;
	#address-cells = <1>;
	#size-cells = <0>;

	eth0_phy: ethernet-phy@1 {
		compatible = "ethernet-phy-ieee802.3-c22";
		reg = <1>;
	};
};
```

## Documentation/devicetree/bindings/watchdog/sigma,8642-wdt.txt
```
Sigma Designs SMP86xx watchdog

Required properties:
- compatible: Should be "sigma,smp8642-wdt"
- reg: Specifies the physical address region
- clocks: Should be a phandle to the clock

Example:

watchdog@1fd00 {
	compatible = "sigma,smp8642-wdt";
	reg = <0x1fd00 8>;
	clocks = <&xtal_in_clk>;
};
```

## arch/arm/mach-tangox/Kconfig
```kconfig
config ARCH_TANGOX
	bool "Sigma Designs SMP87xx" if ARCH_MULTI_V7
	select ARCH_HAS_HOLES_MEMORYMODEL
	select ARM_ERRATA_754322
	select ARM_ERRATA_764369 if SMP
	select ARM_GIC
	select CLKSRC_TANGOX
	select COMMON_CLK
	select HAVE_ARM_SCU
	select HAVE_ARM_TWD if SMP
	select TANGO_IRQ
```

## arch/mips/tangox/Kconfig
```kconfig
if ARCH_TANGO

choice
	prompt "Processor core"

config TANGOX_CPU
	bool "CPU (74Kf)"

config TANGOX_IPU
	bool "IPU (4KEc)"

endchoice

choice
	prompt	"Devicetree"

config DTB_PCH_C200
	bool "Popcorn Hour C-200"
	depends on TANGOX_CPU

config DTB_TANGOX_IPU
	bool "SMP86xx IPU"
	depends on TANGOX_IPU

endchoice

config TANGOX_REMAP
	bool "Physical address remapping"
	help
	  The SMP86xx chips can remap a range of CPU physical
	  addresses to different bus addresses. This can be used to
	  access RAM above 512MB without highmem.

	  Say y to retain the mapping configured by the boot loader.

	  Say n to force an identity mapping and save a slight
	  overhead in DMA setup. The kernel must be loaded to an
	  identity-mapped region.

config TANGOX_EARLY_CONSOLE_PORT
	int "Early console port"
	depends on EARLY_PRINTK
	default 0

config TANGOX_EARLY_CONSOLE_RATE
	int "Early console rate"
	depends on EARLY_PRINTK
	default 115200

config TANGOX_XENV_READ
	bool "Read XENV parameters"

menu "XENV fallback settings"

config TANGOX_XENV_DEF_UART0
	bool "UART0 enabled"
	default y

config TANGOX_XENV_DEF_UART1
	bool "UART1 enabled"
	default y

config TANGOX_XENV_DEF_BAUDRATE
	int "Default baudrate"
	default 115200

config TANGOX_XENV_DEF_ENET
	bool "Ethernet enabled"
	default n

config TANGOX_XENV_DEF_FIP
	bool "FIP enabled"
	default n

config TANGOX_XENV_DEF_I2CM
	bool "I2CM enabled"
	default n

config TANGOX_XENV_DEF_I2CS
	bool "I2CS enabled"
	default n

config TANGOX_XENV_DEF_IR
	bool "IR enabled"
	default n

config TANGOX_XENV_DEF_USB
	bool "USB enabled"
	default n

config TANGOX_XENV_DEF_SATA
	bool "SATA enabled"
	default n

config TANGOX_XENV_DEF_PCIHOST
	bool "PCI Host enabled"
	default n

config TANGOX_XENV_DEF_PCI_ID1
	bool "PCI device 1 enabled"
	depends on TANGOX_XENV_DEF_PCIHOST
	default n

config TANGOX_XENV_DEF_PCI_ID2
	bool "PCI device 2 enabled"
	depends on TANGOX_XENV_DEF_PCIHOST
	default n

config TANGOX_XENV_DEF_PCI_ID3
	bool "PCI device 3 enabled"
	depends on TANGOX_XENV_DEF_PCIHOST
	default n

config TANGOX_XENV_DEF_PCI_ID4
	bool "PCI device 4 enabled"
	depends on TANGOX_XENV_DEF_PCIHOST
	default n

endmenu

endif
```

## drivers/net/ethernet/sigmadesigns/Kconfig
```kconfig
#
# Sigma Designs device configuration
#

config NET_VENDOR_SIGMADESIGNS
	bool "Sigma Designs devices"
	default y
	depends on TANGOX
	---help---
	  Support Sigma Designs' SoC.

config TANGO2_ENET
	tristate "SMP863x Builtin Ethernet support"
	depends on ETHERNET && TANGO2 && NET_VENDOR_SIGMADESIGNS
	select MII
	select CRC32
	---help---
	  This option adds support for the SMP863x integrated Ethernet
	  controller.  This driver uses NAPI and generic Linux MII
	  support.

config TANGOX_ENET
	tristate "SMP8xxx Builtin Gigabit Ethernet support (SMP864x/SMP865x/SMP867x/SMP868x/SMP89xx)"
	depends on ETHERNET && (TANGO3 || TANGO4) && NET_VENDOR_SIGMADESIGNS
	select MII
	select CRC32
	help
	 This option adds support for the SMP8xxx integrated Gigabit Ethernet
	 controller.  This driver uses NAPI and generic Linux MII
	 support.

config TANGOX_ENET0_NOMDIO
	bool "No MDIO access on ethernet 0"
	depends on TANGOX_ENET
	default n
	help
	 This option disable the MDIO access, which is needed for some PHY 
	 emulation device (e.g. Ralink RT2880F wireless card).

config TANGOX_ENET0_NOMDIO_SPEED
	int "Hard wired communication speed"
	depends on TANGOX_ENET0_NOMDIO
	default 100
	help
	 Without MDIO access, the speed needs to be hardwired. Valid number
	 is 10 or 100.

config TANGOX_ENET0_NOMDIO_FULLDUPLEX
	bool "Hard wired duplex mode"
	depends on TANGOX_ENET0_NOMDIO
	default y
	help
	 Without MDIO access, the duplex mode needs to be hardwired. 

config TANGOX_ENET0_NOMDIO_PHY_ADDR
	int "Hard wired PHY address"
	depends on TANGOX_ENET0_NOMDIO
	default 1
	help
	 Without MDIO access, the PHY address speed needs to be hardwired. 
	 Valid number is 0~31.

config TANGOX_ENET1_NOMDIO
	bool "No MDIO access on ethernet 1"
	depends on TANGOX_ENET
	default n
	help
	 This option disable the MDIO access, which is needed for some PHY 
	 emulation device (e.g. Ralink RT2880F wireless card).

config TANGOX_ENET1_NOMDIO_SPEED
	int "Hard wired communication speed"
	depends on TANGOX_ENET1_NOMDIO
	default 100
	help
	 Without MDIO access, the speed needs to be hardwired. Valid number
	 is 10 or 100.

config TANGOX_ENET1_NOMDIO_FULLDUPLEX
	bool "Hard wired duplex mode"
	depends on TANGOX_ENET1_NOMDIO
	default y
	help
	 Without MDIO access, the duplex mode needs to be hardwired. 

config TANGOX_ENET1_NOMDIO_PHY_ADDR
	int "Hard wired PHY address"
	depends on TANGOX_ENET1_NOMDIO
	default 1
	help
	 Without MDIO access, the PHY address speed needs to be hardwired. 
	 Valid number is 0~31.
```

## drivers/net/ethernet/tangox/Kconfig
```kconfig
config TANGOX_ENET
	tristate "SMP86xx Builtin Gigabit Ethernet support"
	depends on ARCH_TANGOX
	select PHYLIB
	help
	 This option adds support for the SMP86xx integrated Gigabit Ethernet
	 controller.

config TANGOX_ENET_PCH_C200_FIXUP
	bool "Popcorn Hour C-200 PHY fixup"
	depends on TANGOX_ENET
	select PHYLIB
	help
	  Fix misconfigured Ethernet PHY on Popcorn Hour C-200 boards.
```
